## main/Kconfig.projbuild
```kconfig
menu "HardFOC Vortex main (app)"

    choice VORTEX_APP_CAN_BOOT_WORKER
        prompt "CAN RX drain worker at boot"
        default VORTEX_APP_CAN_BOOT_NONE
        help
            Only one owner may take the frames of the TWAI controller.
            Pick the CANopen device or none.
            The CANopen device requires "Build the CANopenNode stack" in
            HardFOC Vortex HAL.

        config VORTEX_APP_CAN_BOOT_CANOPEN_SLAVE
            bool "CANopen device (CoNode over the Vortex OD)"
            depends on HARDFOC_HAL_CANOPENNODE_SLAVE
            help
                CoNode: CANopenNode over the object dictionary generated from
                od/vortex_od.yaml, on the TWAI port (hf-core EspTwaiPort),
                served by the co_svc task.

        config VORTEX_APP_CAN_BOOT_NONE
            bool "None"
    endchoice

    config VORTEX_CANOPEN_NODE_ID
        int "CANopen node ID (CANopen device)"
        range 1 127
        default 1
        help
            Node-ID of the CANopen device until LSS assigns one (the LSS
            record in NVS takes over with step 7 of the CANopen plan).

endmenu
```
